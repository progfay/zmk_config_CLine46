## boards/shields/CLine46/Kconfig.defconfig
```kconfig
if SHIELD_CLINE46_R

config ZMK_KEYBOARD_NAME
    default "CLine46"

config ZMK_BLE
    default y

config ZMK_SPLIT_ROLE_CENTRAL
    default y

config INPUT
    default y

config ZMK_POINTING
    default y

config SPI
    default y

config PMW3610
    default y

endif


if SHIELD_CLINE46_R || SHIELD_CLINE46_L

config NFCT_PINS_AS_GPIOS
    default y

config ZMK_SPLIT
    default y

# Battery reporting / sleep (両半身共通)
config ZMK_BATTERY_REPORTING
    default y

config ZMK_IDLE_TIMEOUT
    default 30000

config ZMK_SLEEP
    default y

config ZMK_IDLE_SLEEP_TIMEOUT
    default 1800000

# NiMH (non-LiPo) battery management (両半身共通)
config ZMK_NON_LIPO_BATTERY_MANAGEMENT
    default y

config ZMK_NON_LIPO_MAX_MV
    default 1360

config ZMK_NON_LIPO_MIN_MV
    default 1020

config ZMK_NON_LIPO_LOW_MV
    default 1000

# RGBLED widget battery thresholds (両半身共通)
config RGBLED_WIDGET_BATTERY_LEVEL_HIGH
    default 30

config RGBLED_WIDGET_BATTERY_LEVEL_CRITICAL
    default 10

endif
```

## dts/bindings/behaviors/cline46,behavior-bt-toggle.yaml
```yaml
# Copyright (c) 2026 progfay
# SPDX-License-Identifier: MIT

description: Toggle the active BLE profile between two fixed profile indices

compatible: "cline46,behavior-bt-toggle"

include: zero_param.yaml

properties:
  profile-a:
    type: int
    required: true
    description: First BLE profile index to toggle between
  profile-b:
    type: int
    required: true
    description: Second BLE profile index to toggle between
```

## dts/bindings/behaviors/cline46,behavior-local-morph.yaml
```yaml
# Copyright (c) 2026 progfay
# SPDX-License-Identifier: MIT

description: |
  Mod-morph whose modifier mask only applies to the morph binding's press report.
  Unlike zmk,behavior-mod-morph, the mask is not held until release, so keys
  pressed while this one is held keep the physically held modifiers.

compatible: "cline46,behavior-local-morph"

include: zero_param.yaml

properties:
  bindings:
    type: phandle-array
    required: true
  mods:
    type: int
    required: true
  keep-mods:
    type: int
    required: false
```
